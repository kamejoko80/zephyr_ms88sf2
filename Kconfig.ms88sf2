## Kconfig.ms88sf2
```kconfig
orsource "./$(BOARD_DIR)/Kconfig.board"
orsource "./$(BOARD_DIR)/Kconfig"

menu "MS88SF2 Zephyr"

#rsource "modules/Kconfig"
#rsource "drivers/Kconfig"

endmenu
```

## boards/arm/ms88sf2_nrf52840/Kconfig
```kconfig
# MS88SF2 board configuration

# Copyright (c) 2023 Phuong Dang
# SPDX-License-Identifier: Apache-2.0

if BOARD_MS88SF2_NRF52840

config BOARD_ENABLE_DCDC
	bool "DCDC mode"
	select SOC_DCDC_NRF52X
	default y

config BOARD_ENABLE_DCDC_HV
	bool "High Voltage DCDC converter"
	select SOC_DCDC_NRF52X_HV
	default y

endif # BOARD_MS88SF2_NRF52840
```

## boards/arm/ms88sf2_nrf52840/Kconfig.board
```kconfig
# MS88SF2 board configuration

# Copyright (c) 2023 Phuong Dang
# SPDX-License-Identifier: Apache-2.0

config BOARD_MS88SF2_NRF52840
	bool "MS88SF2"
	depends on SOC_NRF52840_QIAA
```

## boards/arm/ms88sf2_nrf52840/Kconfig.defconfig
```kconfig
# MS88SF2 board configuration

# Copyright (c) 2023 Phuong Dang
# SPDX-License-Identifier: Apache-2.0

if BOARD_MS88SF2_NRF52840

config BOARD
	default "ms88sf2_nrf52840"

config BT_CTLR
	default BT

endif # BOARD_MS88SF2_NRF52840
```

## west.yml
```yaml
manifest:
  version: "0.12"
  remotes:
    - name: zephyr_ms88sf2
      url-base: git@github.com:kamejoko80/zephyr_ms88sf2.git
    - name: zephyrproject
      url-base: https://github.com/zephyrproject-rtos

  defaults:
    remote: zephyr_ms88sf2

  projects:
    - name: zephyr
      repo-path: zephyr
      remote: zephyrproject
      revision: 41814f8c3bb076656197a78700d2b41ea9500c38
      import:
        name-whitelist:
          - cmsis
          - edtt
          - fatfs
          - hal_nordic
          - libmetal
          - littlefs
          - lvgl
          - mbedtls
          - mcumgr
          - mipi-sys-t
          - net-tools
          - nrf_hw_models
          - openthread
          - segger
  self:
    path: ms88sf2
```
